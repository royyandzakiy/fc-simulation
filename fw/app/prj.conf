## CMakeLists.txt
```
cmake_minimum_required(VERSION 3.20.0)
find_package(Zephyr REQUIRED HINTS $ENV{ZEPHYR_BASE})
project(fc_fw)

include(${CMAKE_CURRENT_LIST_DIR}/../cmake/fc_core.cmake)
target_sources(app PRIVATE src/main.cpp)
```

## Kconfig
```
menu "Flight controller"

config FC_ARM_THRESHOLD_PERMILLE
	int "Arm channel threshold, in thousandths of full scale"
	range -1000 1000
	default 500
	help
	  The arm switch counts as up above this, with fc::ArmSwitch's
	  hysteresis either side. Same as the host build's --arm-threshold.

config FC_ARM_HOLD_MS
	int "Arm switch hold time (ms)"
	default 200
	help
	  The switch must stay up this long before the controller arms.
	  Disarm is always immediate.

config FC_RC_TIMEOUT_MS
	int "RC-loss failsafe timeout (ms)"
	default 500
	help
	  Disarm once no frame with valid sticks has arrived for this long.

endmenu

source "Kconfig.zephyr"
```

## sample.yaml
```
sample:
  name: flight controller firmware
common:
  tags: fc
tests:
  fc.app:
    build_only: true
    platform_allow:
      - native_sim/native/64
      - esp32_devkitc/esp32/procpu
    integration_platforms:
      - native_sim/native/64
```

## prj.conf
```kconfig
# The flight core is C++23 with std::array, so it needs the full standard
# library, not Zephyr's minimal one.
CONFIG_CPP=y
CONFIG_STD_CPP23=y
CONFIG_REQUIRES_FULL_LIBCPP=y

CONFIG_SERIAL=y
CONFIG_LOG=y
```

## boards/esp32_devkitc_procpu.conf
```kconfig
# uart0 carries the link, so nothing else may write to it: a single log line
# in the middle of a motor frame desyncs the plant.
CONFIG_LOG=n
CONFIG_PRINTK=n
CONFIG_CONSOLE=n
CONFIG_UART_CONSOLE=n
CONFIG_BOOT_BANNER=n
```

## boards/native_sim_native_64.conf
```kconfig
# printk and logs go to zephyr.exe's stdout through the native console and
# log backend, which the launching script reads.
CONFIG_UART_CONSOLE=n

# 10 kHz tick. The default 100 Hz rounds every k_usleep() up to 10 ms, which
# alone makes a lockstep round trip slower than the 4.17 ms control period.
CONFIG_SYS_CLOCK_TICKS_PER_SEC=10000

# Plain log lines: colour codes are noise once the plant prefixes and prints them.
CONFIG_LOG_BACKEND_SHOW_COLOR=n
```

## boards/esp32_devkitc_procpu.overlay
```dts
/* Link on uart0, the DevKitC's USB-UART bridge, the only port reachable
 * without extra wiring. 460800 baud leaves headroom at 240 Hz: 82 B per
 * exchange is 1.8 ms on the wire against a 4.17 ms period.
 */
/ {
	chosen {
		fc,link-uart = &uart0;
	};
};

&uart0 {
	current-speed = <460800>;
};
```

## src/main.cpp
```c
// Flight controller firmware, simulator-in-the-loop build.
//
// Sensor frames arrive on the link UART, sticks ride inside them, and every
// frame is answered with one motor frame. The plant owns time: dt comes from
// the frame, so the run is lockstep and reproducible, the same as the host
// build fc_sitl_cpp with --input link.

#include "fc/core.hpp"
#include "fc/link.hpp"

#include <zephyr/device.h>
#include <zephyr/drivers/uart.h>
#include <zephyr/kernel.h>
#include <zephyr/logging/log.h>

LOG_MODULE_REGISTER(fc, LOG_LEVEL_INF);

namespace {

const device *const kLink = DEVICE_DT_GET(DT_CHOSEN(fc_link_uart));

// Blocks until a byte arrives. The short sleep keeps native_sim off 100% CPU
// and costs at most 50 us per idle poll.
std::uint8_t read_byte() {
	unsigned char c;
	while (uart_poll_in(kLink, &c) != 0)
		k_usleep(50);
	return c;
}

void write_frame(const fc::link::MotorBytes &bytes) {
	for (const auto b : bytes)
		uart_poll_out(kLink, b);
}

} // namespace

int main() {
	if (!device_is_ready(kLink)) {
		LOG_ERR("link uart %s not ready", kLink->name);
		return 0;
	}

	fc::LinkSticks sticks;
	sticks.configure(CONFIG_FC_ARM_THRESHOLD_PERMILLE / 1000.0f, CONFIG_FC_ARM_HOLD_MS / 1000.0f,
					 CONFIG_FC_RC_TIMEOUT_MS / 1000.0f);
	fc::Controller controller;
	fc::link::SensorReader reader;

	LOG_INF("link on %s, arm >%d/1000 held %d ms, rc timeout %d ms", kLink->name,
			CONFIG_FC_ARM_THRESHOLD_PERMILLE, CONFIG_FC_ARM_HOLD_MS, CONFIG_FC_RC_TIMEOUT_MS);

	bool was_armed = false;
	bool was_lost = true;

	for (;;) {
		const auto res = reader.push(read_byte());
		if (res == fc::link::SensorReader::Result::BadCrc) {
			LOG_WRN("rx: bad crc, dropping");
			continue;
		}
		if (res != fc::link::SensorReader::Result::Frame)
			continue;
		const auto &s = reader.frame();

		const fc::Sticks rc = sticks.poll(s.rc, s.dt);
		const fc::link::MotorFrame out{
			.seq = s.seq,
			.m = controller.step(s.gyro, rc, s.dt),
			.rc = {rc.roll, rc.pitch, rc.yaw, rc.throttle},
			.armed = rc.armed,
		};
		write_frame(fc::link::encode_motor(out));

		// Reported after the reply, so logging never delays the frame.
		if (sticks.refused())
			LOG_WRN("arm refused, throttle %d%%, bring it down first", static_cast<int>(s.rc.rc[3] * 100.0f));
		if (sticks.rc_lost() != was_lost) {
			was_lost = sticks.rc_lost();
			if (was_lost)
				LOG_WRN("no valid sticks, failsafe");
			else
				LOG_INF("sticks valid");
		}
		if (rc.armed != was_armed) {
			was_armed = rc.armed;
			LOG_INF("%s", rc.armed ? "ARMED" : "disarmed");
		}
	}
}
```
