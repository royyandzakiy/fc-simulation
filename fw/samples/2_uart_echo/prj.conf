## CMakeLists.txt
```
cmake_minimum_required(VERSION 3.20.0)
find_package(Zephyr REQUIRED HINTS $ENV{ZEPHYR_BASE})
project(uart_echo)

target_sources(app PRIVATE src/main.cpp)
```

## sample.yaml
```
sample:
  name: link uart echo
common:
  tags: fc
tests:
  fc.samples.uart_echo:
    build_only: true
    platform_allow:
      - native_sim/native/64
      - esp32_devkitc/esp32/procpu
    integration_platforms:
      - native_sim/native/64
```

## prj.conf
```kconfig
CONFIG_CPP=y
CONFIG_STD_CPP23=y

CONFIG_SERIAL=y
CONFIG_LOG=y
```

## boards/esp32_devkitc_procpu.overlay
```dts
/* Link on uart0, the DevKitC's USB-UART bridge. Logs share it in this
 * sample, so echoed bytes and log lines interleave in a terminal.
 */
/ {
	chosen {
		fc,link-uart = &uart0;
	};
};
```

## boards/native_sim_native_64.overlay
```dts
/* Link on the second pty. The first one is disabled: logs go to
 * zephyr.exe's stdout instead, so there is exactly one pty to find.
 */
/ {
	chosen {
		fc,link-uart = &uart1;
	};
};

&uart0 {
	status = "disabled";
};

&uart1 {
	status = "okay";
};
```

## src/main.cpp
```c
// Echoes every byte that arrives on the link UART. The first thing the
// simulator needs from firmware: a device path that answers.

#include <zephyr/device.h>
#include <zephyr/drivers/uart.h>
#include <zephyr/kernel.h>
#include <zephyr/logging/log.h>

LOG_MODULE_REGISTER(uart_echo, LOG_LEVEL_INF);

namespace {
const device *const kLink = DEVICE_DT_GET(DT_CHOSEN(fc_link_uart));
} // namespace

int main() {
	if (!device_is_ready(kLink)) {
		LOG_ERR("link uart %s not ready", kLink->name);
		return 0;
	}
	LOG_INF("echoing on %s", kLink->name);

	for (;;) {
		unsigned char c;
		if (uart_poll_in(kLink, &c) == 0) {
			uart_poll_out(kLink, c);
			continue;
		}
		// Nothing pending. Polling with a short sleep keeps native_sim off
		// 100% CPU while adding at most this much latency per byte.
		k_usleep(50);
	}
}
```
